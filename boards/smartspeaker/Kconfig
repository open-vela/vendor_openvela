## boards/vela/configs/goldfish-x86_64-ap-citest/defconfig
```kconfig
#include "../goldfish-x86_64-ap/defconfig"
CONFIG_ALLOW_MIT_COMPONENTS=y
CONFIG_CM_FS_TEST=y
CONFIG_CM_MM_TEST=y
CONFIG_CM_SOCKET_TEST=y
CONFIG_EXAMPLES_HELLOXX=y
CONFIG_EXAMPLES_PIPE=y
CONFIG_EXAMPLES_PIPE_STACKSIZE=4096
CONFIG_EXAMPLES_POPEN=y
CONFIG_EXAMPLES_POPEN_STACKSIZE=8192
CONFIG_LIBC_ENVPATH=n
CONFIG_LIBC_EXECFUNCS=n
CONFIG_LIBC_SCANSET=y
CONFIG_LIBUV_THREAD_STACKSIZE=16384
CONFIG_LIBUV_UTILS_STACKSIZE=65536
CONFIG_LIBUV_UTILS_TEST=y
CONFIG_PTHREAD_MUTEX_BOTH=y
CONFIG_SYSTEM_POPEN=y
CONFIG_SYSTEM_POPEN_STACKSIZE=8192
CONFIG_TESTING_CMOCKA=y
CONFIG_TESTING_CMOCKA_STACKSIZE=8192
CONFIG_TESTING_CXXTEST=y
CONFIG_TESTING_FSTEST=y
CONFIG_TESTING_FSTEST_STACKSIZE=8192
CONFIG_TESTING_GETPRIME=y
CONFIG_TESTING_GETPRIME_STACKSIZE=4096
CONFIG_TESTING_MM=y
CONFIG_TESTING_MM_STACKSIZE=4096
CONFIG_TESTING_SCANFTEST=y
CONFIG_TESTING_SCANFTEST_STACKSIZE=4096
CONFIG_TESTS_TESTSUITES=y
```
