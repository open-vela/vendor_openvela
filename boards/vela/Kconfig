## boards/vela/Kconfig
```kconfig
#
# For a description of the syntax of this configuration file,
# see the file kconfig-language.txt in the NuttX tools repository.
#

choice
	prompt "Select subsystem"

config VELA_AP
	bool "VELA QEMU AP"
	---help---
		vela qemu ap

config VELA_BL
	bool "VELA QEMU BL"
	---help---
		vela qemu bootloader

config VELA_TEE
	bool "VELA QEMU TEE"
	---help---
		vela qemu tee

config VELA_DROID
	bool "VELA QEMU DROID"
	---help---
		vela qemu droid

endchoice

if ARCH_BOARD_CUSTOM

endif
```

## boards/vela/configs/goldfish-armeabi-v7a-ap-citest/defconfig
```kconfig
#include "../goldfish-armeabi-v7a-ap/defconfig"
CONFIG_ALLOW_MIT_COMPONENTS=y
CONFIG_BCH=y
CONFIG_CM_FS_TEST=y
CONFIG_CM_KVDB_TEST=y
CONFIG_CM_MM_TEST=y
CONFIG_CM_SOCKET_TEST=y
CONFIG_EXAMPLES_HELLOXX=y
CONFIG_EXAMPLES_POPEN=y
CONFIG_EXAMPLES_USRSOCKTEST=y
CONFIG_FS_AIO=y
CONFIG_FS_SHMFS=y
CONFIG_LIBC_MEMFD_TMPFS=y
CONFIG_LIBUV_THREAD_STACKSIZE=16384
CONFIG_LIBUV_UTILS_STACKSIZE=65536
CONFIG_LIBUV_UTILS_TEST=y
CONFIG_MQ_MAXMSGSIZE=64
CONFIG_NETUTILS_NETINIT=y
CONFIG_NET_USRSOCK=y
CONFIG_NSH_LINELEN=2048
CONFIG_NSH_MAXARGUMENTS=16
CONFIG_PTHREAD_MUTEX_BOTH=y
CONFIG_SCHED_LPNTHREADS=1
CONFIG_SYSTEM_POPEN=y
CONFIG_TESTING_CMOCKA=y
CONFIG_TESTING_CMOCKA_STACKSIZE=8192
CONFIG_TESTING_DRIVER_TEST=y
CONFIG_TESTING_DRIVER_TEST_STACKSIZE=8192
CONFIG_TESTING_FATUTF8=y
CONFIG_TESTING_FSTEST=y
CONFIG_TESTING_FSTEST_STACKSIZE=8192
CONFIG_TESTING_LTP=y
CONFIG_TESTING_LTP_STACKSIZE=8192
CONFIG_TESTING_MM=y
CONFIG_TESTING_SCANFTEST=y
CONFIG_LIBC_SCANSET=y
CONFIG_TESTS_TESTSUITES=y
```
